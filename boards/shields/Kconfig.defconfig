## boards/shields/Kconfig.defconfig
```kconfig
if SHIELD_anex128_LEFT

config ZMK_KEYBOARD_NAME
    default "Anex1.28"

config ZMK_SPLIT_ROLE_CENTRAL
    default y

endif # SHIELD_anex128_LEFT

if SHIELD_anex128_LEFT || SHIELD_anex128_RIGHT

config ZMK_SPLIT
    default y

endif # SHIELD_anex128_LEFT || SHIELD_anex128_RIGHT
```

## boards/shields/Kconfig.shield
```kconfig
config SHIELD_anex128_LEFT
    def_bool $(shields_list_contains,anex128_left)

config SHIELD_anex128_RIGHT
    def_bool $(shields_list_contains,anex128_right)
```

## boards/shields/anex124w/Kconfig.defconfig
```kconfig
if SHIELD_anex124w_LEFT

config ZMK_KEYBOARD_NAME
    default "Anex1.24W"

config ZMK_SPLIT_ROLE_CENTRAL
    default y

endif # SHIELD_anex124w_LEFT

if SHIELD_anex124w_LEFT || SHIELD_anex124w_RIGHT

config ZMK_SPLIT
    default y

endif # SHIELD_anex124w_LEFT || SHIELD_anex124w_RIGHT
```

## boards/shields/anex124w/Kconfig.shield
```kconfig
config SHIELD_anex124w_LEFT
    def_bool $(shields_list_contains,anex124w_left)

config SHIELD_anex124w_RIGHT
    def_bool $(shields_list_contains,anex124w_right)
```
